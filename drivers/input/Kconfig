## drivers/input/Kconfig
```kconfig
# Copyright (c) 2022 The ZMK Contributors
# SPDX-License-Identifier: MIT

DT_COMPAT_ZMK_INPUT_PROCESSOR_ABSOLUTE_TO_RELATIVE := zmk,input-processor-absolute-to-relative

config ZMK_INPUT_PROCESSOR_ABSOLUTE_TO_RELATIVE
		bool
		default $(dt_compat_enabled,$(DT_COMPAT_ZMK_INPUT_PROCESSOR_ABSOLUTE_TO_RELATIVE))
		depends on ZMK_POINTING && USB_DEVICE_HID

config INPUT_PROCESSOR_ABSOLUTE_TO_RELATIVE_INIT_PRIORITY
    int "Input processor initialization priority"
    default INPUT_INIT_PRIORITY
    depends on ZMK_INPUT_PROCESSOR_ABSOLUTE_TO_RELATIVE
```

## dts/bindings/input/zmk,input-processor-additional-behaviors.yaml
```yaml
description: |
  Sensor driver for the Cirque Pinnacle trackpad ASICs, using the I2C interface

compatible: "zmk,input-processor-tap"

include: ["zmk,input-processor-tap.yaml"]
```

## dts/bindings/zmk,input-processor-absolute-to-relative.yaml
```yaml
# Copyright (c) 2021 The ZMK Contributors
# SPDX-License-Identifier: MIT

description: Converts absolute mouse movements to relative ones and instantly reports them

compatible: "zmk,input-processor-absolute-to-relative"

include: ip_zero_param.yaml
```

## dts/bindings/zmk,input-processor-tap.yaml
```yaml
# Copyright (c) 2021 The ZMK Contributors
# SPDX-License-Identifier: MIT

description: Detects a tap on a touchpad

compatible: "zmk,input-processor-tap"

include: bindings/input_processors/ip_one_param.yaml

properties:
  timeout:
    type: int
    required: false
    default: 20
    description: Time in milliseconds that a touch takes to be a tap before it is considered a continuous touch.
```
